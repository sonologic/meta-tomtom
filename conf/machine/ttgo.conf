## conf/machine/ttgo.conf
```bitbake
#@TYPE: Machine
#@NAME: ttgo
#@DESCRIPTION: ttgo

MACHINE_FEATURES = "apm alsa"

IMAGE_FSTYPES += "tar.bz2 ext3"

ROOT_FLASH_SIZE = "280"

RDEPENDS_kernel-base = ""

PREFERRED_PROVIDER_virtual/kernel ?= "linux-tomtom"

EXTRA_IMAGEDEPENDS += ""

require conf/machine/include/tune-arm920t.inc

KERNEL_IMAGETYPE = "zImage"
SERIAL_CONSOLE = "115200 ttyS0"
```
